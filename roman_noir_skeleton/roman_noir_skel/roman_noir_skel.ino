#include <Arduboy2.h>
#include "Tinyfont.h"

Arduboy2 arduboy;
Tinyfont tinyfont = Tinyfont(arduboy.sBuffer, Arduboy2::width(), Arduboy2::height());

const unsigned char PROGMEM title[] =
{
// width, height,
128, 64,
0x00, 0xfe, 0xfe, 0xfe, 0xfe, 0xfe, 0x1e, 0x1e, 0x1e, 0x1e, 0x1e, 0x1e,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 0x00, 
0x00, 0x7f, 0x7f, 0x7f, 0x7f, 0x7f, 0x0f, 0x0f, 0x0f, 0x0f, 0x0f, 0x0f,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 0x00, 
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0x00, 0x00, 0x00, 0x00, 0x00, 0x00, 0x00, 0x00, 0x00, 0x00, 0x00, 0x00,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 0x00, 
};

const unsigned char PROGMEM notebook[] =
{
// width, height,
128, 64,
0xff, 0xff, 0xff, 0xff, 0xff, 0xff, 0xff, 0xff, 0xff, 0xff, 0xff, 0xff,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 0xff, 
0xff, 0xff, 0x1f, 0x0f, 0x0f, 0x0f, 0x0f, 0x1f, 0xff, 0xff, 0xff, 0xff,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 0xff, 
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0xff, 0xff, 0xfe, 0xfc, 0xfc, 0xfc, 0xfc, 0xfe, 0xff, 0xff, 0xff, 0xff,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 0xff, 
};

const unsigned char PROGMEM hongkongflag[] =
{
// width, height,
128, 64,
0x00, 0x00, 0x00, 0x00, 0x00, 0x00, 0x00, 0x00, 0x00, 0x00, 0x00, 0x00,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 0x00, 
0x00, 0x00, 0x00, 0x00, 0x00, 0x00, 0x00, 0x00, 0x00, 0x00, 0x00, 0x00,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 0x00, 
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0x00, 0x00, 0x00, 0x00, 0x00, 0x00, 0x00, 0x00, 0x00, 0x00, 0x00, 0x00,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 0x00, 
};

const unsigned char PROGMEM woman[] =
{
// width, height,
32, 28,
0x00, 0xfc, 0x83, 0x88, 0x87, 0xf2, 0xf9, 0xbd, 0xde, 0xdf, 0xcf, 0xcf, 0xef, 0xff, 0xff, 0xfe, 0xff, 0xfe, 0xff, 0xef, 0xcf, 0xcf, 0xdf, 0xde, 0xbc, 0xf9, 0xf2, 0x8e, 0xda, 0x8b, 0xfc, 0x00, 
0x30, 0xfd, 0xc4, 0x81, 0x7f, 0xff, 0xff, 0xfb, 0xf9, 0xfc, 0xfa, 0xfa, 0xfc, 0xff, 0xff, 0xff, 0xff, 0xc7, 0x1f, 0x7d, 0xfa, 0xfa, 0xfc, 0xf9, 0xfb, 0xff, 0xff, 0x7f, 0x81, 0xc4, 0xfd, 0x30, 
0x00, 0x00, 0x01, 0x01, 0x00, 0x01, 0x03, 0x0f, 0x1f, 0x3f, 0x7f, 0xfb, 0xe7, 0xd3, 0x92, 0x97, 0x97, 0x92, 0xd2, 0xe7, 0xfb, 0x7f, 0x3f, 0x1f, 0x0f, 0x03, 0x01, 0x00, 0x01, 0x01, 0x00, 0x00, 
0x00, 0x00, 0x00, 0x00, 0x00, 0x00, 0x00, 0x00, 0x08, 0x0f, 0x0f, 0x0e, 0x09, 0x03, 0x03, 0x07, 0x07, 0x03, 0x03, 0x01, 0x00, 0x00, 0x0f, 0x08, 0x00, 0x00, 0x00, 0x00, 0x00, 0x00, 0x00, 0x00, 
};

const unsigned char PROGMEM hkmapbig[] =
{
// width, height,
86, 64,
0x00, 0x00, 0x00, 0x00, 0x00, 0x00, 0x00, 0x00, 0x00, 0x00, 0x00, 0x00,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 0x00, 
0x00, 0x00, 0x00, 0x00, 0x00, 0x00, 0x00, 0x00, 0x00, 0x00, 0x00, 0x00,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 0x00, 
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0x06, 0x0e, 0x3f, 0x3f, 0x0f, 0x0f, 0x07, 0x03, 0x01, 0x01, 0x03, 0x03,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 0x00, 
};

const unsigned char PROGMEM hkmap1inv[] =
{
// width, height,
128, 64,
0x00, 0x00, 0x00, 0x00, 0x00, 0x00, 0x00, 0x00, 0x00, 0x00, 0x00, 0x00,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 0x00, 
0x00, 0x00, 0x00, 0x00, 0x00, 0x00, 0x00, 0x00, 0x00, 0x00, 0x00, 0x00,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 0x00, 
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0x00, 0x00, 0x00, 0x00, 0x00, 0x00, 0x00, 0x00, 0x00, 0x00, 0x00, 0x00,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 0xff, 
};

const unsigned char PROGMEM hkmap2inv[] =
{
// width, height,
128, 64,
0x00, 0x00, 0x00, 0x00, 0x00, 0x00, 0x00, 0x00, 0x00, 0x00, 0x00, 0x00,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 0x00, 
0x00, 0x00, 0x00, 0x00, 0x00, 0x00, 0x00, 0x00, 0x00, 0x00, 0x00, 0x00,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 0x00, 
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0xff, 0xff, 0xff, 0xff, 0xff, 0xff, 0xff, 0xff, 0xff, 0xff, 0xff, 0xff,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 0x00, 
};

const unsigned char PROGMEM hkmap3inv[] =
{
// width, height,
128, 64,
0x00, 0x00, 0x00, 0x00, 0x00, 0x00, 0x00, 0x00, 0x00, 0x00, 0x00, 0x00,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 0x00, 
0x00, 0x00, 0x00, 0x00, 0x00, 0x00, 0x00, 0x00, 0x00, 0x00, 0x00, 0x00,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 0x00, 
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0xfe, 0xfc, 0xf0, 0x40, 0x00, 0x01, 0x07, 0xe7, 0xff, 0xff, 0xff, 0xff,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 0x00, 
};

const unsigned char PROGMEM hkmap4inv[] =
{
// width, height,
128, 65,
0x00, 0x00, 0x00, 0x00, 0x00, 0x00, 0x00, 0x00, 0x00, 0x00, 0x00, 0x00,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 0xff, 
0x00, 0x00, 0x00, 0x00, 0x00, 0x00, 0x00, 0x00, 0x00, 0x00, 0x00, 0x00,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 0xff, 
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0x00, 0x00, 0x00, 0x00, 0x00, 0x00, 0x00, 0x00, 0x00, 0x00, 0x00, 0x00,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 0x00, 
};

const unsigned char PROGMEM hkmap5inv[] =
{
// width, height,
128, 64,
0xff, 0xff, 0xff, 0xff, 0xff, 0xff, 0xff, 0xff, 0xff, 0xff, 0xff, 0xff,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 0xff, 
0xff, 0xff, 0xff, 0xff, 0xff, 0xff, 0xff, 0xff, 0xff, 0xff, 0xff, 0xff,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 0xff, 
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0x01, 0x01, 0x00, 0x00, 0x00, 0x00, 0x00, 0x00, 0x00, 0x00, 0x00, 0x00,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 0xff, 
};

const unsigned char PROGMEM hkmap6inv[] =
{
// width, height,
128, 64,
0xff, 0xff, 0xff, 0xfc, 0xf8, 0xf8, 0xff, 0xff, 0xff, 0xff, 0xff, 0xff,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 0x00, 
0xff, 0xff, 0xff, 0xff, 0xff, 0xff, 0xff, 0xff, 0xff, 0xff, 0xff, 0xff,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 0x00, 
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0xff, 0xff, 0xff, 0xff, 0xff, 0xff, 0xff, 0xff, 0xff, 0xff, 0xff, 0x3f,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 0x00, 
};

const unsigned char PROGMEM hkmap7inv[] =
{
// width, height,
128, 64,
0x00, 0x00, 0x00, 0x00, 0x00, 0x00, 0x00, 0x00, 0x00, 0x00, 0x00, 0x00,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 0x00, 
0x00, 0x00, 0x00, 0x00, 0x00, 0x00, 0x00, 0x00, 0x00, 0x00, 0x00, 0x00,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 0x00, 
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0x00, 0x00, 0x00, 0x00, 0x00, 0x00, 0x00, 0x00, 0x00, 0x00, 0x00, 0x00,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 0x00, 
};

const unsigned char PROGMEM hkmap8inv[] =
{
// width, height,
128, 64,
0x00, 0x00, 0x00, 0x00, 0x00, 0x00, 0x00, 0x00, 0x00, 0x00, 0x00, 0x00,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 0x3f, 
0x00, 0x00, 0x00, 0x00, 0x00, 0x00, 0x00, 0x00, 0x00, 0x00, 0x00, 0x00,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 0xfe, 
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0x00, 0x00, 0x00, 0x00, 0x00, 0x00, 0x00, 0x00, 0x00, 0x00, 0x00, 0x00,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 0x01, 
};

const unsigned char PROGMEM hkmap9inv[] =
{
// width, height,
128, 64,
0x7f, 0x7f, 0x7f, 0x7f, 0x7f, 0x7f, 0x7f, 0x3f, 0x0f, 0x07, 0x03, 0x00,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 0x00, 
0xfe, 0xfe, 0xfc, 0xfc, 0xfc, 0xf8, 0xf0, 0xe0, 0xc0, 0xc0, 0xc0, 0xc0,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 0x00, 
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0x01, 0x03, 0x03, 0x01, 0x01, 0x01, 0x00, 0x00, 0x00, 0x00, 0x00, 0x00,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 0x00, 
};

const unsigned char PROGMEM wave[] =
{
// width, height,
4, 2,
0x02, 0x01, 0x01, 0x02, 
};

int currentItem = 0;
int selectedItem = 0;
int currentScreen = 0;
int generalCounter = 0;
int generalSelector = 0;
int xoffseteven = 0;

bool goBackToMenu = true;
bool disableButtons = false;

String textToDisplay = "";

const char menuEntry000[] PROGMEM = "TITLE";
const char menuEntry001[] PROGMEM = "TRANSITION";
const char menuEntry002[] PROGMEM = "NARRATION";
const char menuEntry003[] PROGMEM = "MAPBIG";
const char menuEntry004[] PROGMEM = "GAMEMAPSCR";
const char menuEntry005[] PROGMEM = "GAMEMAPLOC";
const char menuEntry006[] PROGMEM = "PHONEHOME";
const char menuEntry007[] PROGMEM = "PHONEMSG";
const char menuEntry008[] PROGMEM = "SAVE";
const char menuEntry009[] PROGMEM = "DIALOG";
const char menuEntry010[] PROGMEM = "INTRO";
const char menuEntry011[] PROGMEM = "LOCATION";
const char menuEntry012[] PROGMEM = "NOTEBOOK";
const char * const menuEntries[] PROGMEM =
{
  menuEntry000,
  menuEntry001,
  menuEntry002,
  menuEntry003,
  menuEntry004,
  menuEntry005,
  menuEntry006,
  menuEntry007,
  menuEntry008,
  menuEntry009,
  menuEntry010,
  menuEntry011,
  menuEntry012
};
#define MENUENTRIES 13

const char dialog000[] PROGMEM = "= Menu 1/2\n\nTITLE\nTRANSITION\nNARRATION\nMAPBIG\nGAMEMAPSCR\nGAMEMAPLOC\nPHONEHOME\nPHONEMSG\nSAVE\n";
const char dialog001[] PROGMEM = "= Menu 2/2\n\nDIALOG\nINTRO\nLOCATION\nNOTEBOOK\n";
const char dialog002[] PROGMEM = "Il me faut la\nconsolation des\nOmbres\nEt l\`obscurité\nde la nuit.";  
const char dialog003[] PROGMEM = "abcdefghijklmno\npqrstuvwxyz\nABCDEFGHIJKLMNO\nPQRSTUVWXYZ\n0123456789\n";                
const char dialog004[] PROGMEM = "IL ME FAUT LA\nCONSOLATION DES\nOMBRES\nET L\`OBSCURITÉ\nDE LA NUIT.";
const char dialog005[] PROGMEM = "    -=***=-   \nIl me faut la\n\nconsolation des\n\nOmbres\n\nEt l\`obscurité\n\nde la nuit.\n    -=***=-   \n";
const char dialog006[] PROGMEM = "0123456789ABCDEF\n0123456789ABCDEF\n0123456789ABCDEF\n0123456789ABCDEF\n0123456789ABCDEF\n0123456789ABCDEF\n0123456789ABCDEF\n0123456789ABCDEF\n0123456789ABCDEF\n0123456789ABCDEF\n0123456789ABCDEF\n0123456789ABCDEF\n";
const char * const dialogs[] PROGMEM =
{
  dialog000,
  dialog001,
  dialog002,
  dialog003,
  dialog004,
  dialog005,
  dialog006
};
#define DIALOGS 7

const char narration000[] PROGMEM = "Hong Kong, December 5\n\nPrivate detective Jacques Meyer\nlands at the airport.\nHe came there to investigate\nthe disappearance of";
const char narration001[] PROGMEM = "Suzy Gao Xing, a\n26 years old journalist.";
const char * const narration[] PROGMEM = 
{
  narration000,
  narration001
};
#define NARRATION 2

char tBuffer[205];

int menu(int firstEntry, int lastEntry, int currentEntry) {
  // Returns integer pointing to new currentScreen
  int changeScreenAt = 0;
  int currentYPos = 0;
  String prefixArrow = "";
  String suffixArrow = "";
  int currentFirstEntry = firstEntry;
  int currentLastEntry = firstEntry + 8;
  bool exitMenu = false;
  while ( exitMenu == false ) {
    arduboy.clear();
    arduboy.pollButtons();
    changeScreenAt = currentLastEntry;
    if ( changeScreenAt > currentLastEntry ) {
      changeScreenAt = currentLastEntry;
    }
    if ( arduboy.justPressed(UP_BUTTON) ) {
      // UP
      currentEntry -= 1;
      if ( currentEntry < currentFirstEntry ) {
        if ( currentEntry < firstEntry ) {
          // Reached top of the list
          // Looping back to the bottom
          currentFirstEntry = lastEntry - 8;
          currentLastEntry = lastEntry;
          currentEntry = lastEntry;
        } else {
          // Going one page up
          currentFirstEntry -= 8;
          if ( currentFirstEntry < firstEntry ) {
            currentFirstEntry = firstEntry;
          }
          currentLastEntry = currentFirstEntry + 8;
          currentEntry = currentLastEntry;
        }
      }
    } else if ( arduboy.justPressed(DOWN_BUTTON) ) {
      // DOWN
      currentEntry += 1;
      if ( currentEntry > currentLastEntry ) {
        if ( currentEntry > lastEntry ) {
          // Reached bottom of the list
          // Looping back to the top
          currentFirstEntry = firstEntry;
          currentLastEntry = currentFirstEntry + 8;
          currentEntry = currentFirstEntry;
        } else {
          // Going one page down
          currentLastEntry += 8;
          if ( currentLastEntry > lastEntry ) {
            currentLastEntry = lastEntry;
          }
          currentFirstEntry += 8;
          currentEntry = currentFirstEntry;
        }
      }
    } else if ( arduboy.justPressed(A_BUTTON) ) {
      // A
      exitMenu = true;
    }
    tinyfont.setCursor(48, 2);
    tinyfont.print("= Menu =");
    currentYPos = 12;
    for (int i = currentFirstEntry; i <= currentLastEntry; i += 1) {
      tinyfont.setCursor(48, currentYPos);
      if ( i == currentEntry ) {
        // meh
        prefixArrow = "> ";
        suffixArrow = " <";
      } else {
        prefixArrow = "";
        suffixArrow="";
      }
      tinyfont.print(prefixArrow + strcpy_P(tBuffer, (char*)pgm_read_word(&(menuEntries[i]))) + suffixArrow);
      currentYPos += 5;
    }
    tinyfont.setCursor(0, 0);
    tinyfont.print(currentEntry);
    tinyfont.setCursor(0, 5);
    tinyfont.print(currentFirstEntry);
    tinyfont.setCursor(0, 10);
    tinyfont.print(currentLastEntry);
    arduboy.display();
  }
  return currentEntry;
}

void setup() {
  arduboy.begin();
  arduboy.setFrameRate(30);
  arduboy.clear();
}

void dialog(unsigned char PROGMEM portrait[], String charactername, String text) {
  // Display a dialog window
  // portrait: 32x32 b&w picture
  // charactername: 6 chars long string
  // text: 16x12 192 chars long string
  tinyfont.setCursor(10, 50);
  tinyfont.print(charactername);
  tinyfont.setCursor(48, 2);
  tinyfont.print(text);
  tinyfont.setCursor(0, 0);
  tinyfont.print(text.length());
  Sprites::drawOverwrite(8, 16, portrait, 0);
}

void loop() {
  if ( !arduboy.nextFrame() ) {
    return;
  }

  arduboy.clear();
  arduboy.pollButtons();

  if ( goBackToMenu == true ) {
    currentScreen = menu(0, 12, 0);
  }
  
  switch ( currentScreen ) {
    case 0:
      // TITLE
      goBackToMenu = false;
      selectedItem = 0;
      textToDisplay = "> New game\nContinue";
      while ( goBackToMenu == false) {
        arduboy.clear();
        Sprites::drawOverwrite(0, 0, title, 0);
        tinyfont.setCursor(40, 50);
        arduboy.pollButtons();
        if ( arduboy.justPressed(A_BUTTON) ) {
          goBackToMenu = true;
        } else if ( arduboy.justPressed(A_BUTTON) ) {
          goBackToMenu = true;
        } else if ( arduboy.justPressed(UP_BUTTON) || arduboy.justPressed(DOWN_BUTTON) ) {
          if ( selectedItem == 0 ) {
            selectedItem = 1;
            textToDisplay = "New game\n> Continue";
          } else {
            selectedItem = 0;
            textToDisplay = "> New game\nContinue";
          }
        }
        tinyfont.print(textToDisplay);
        arduboy.display();
      }
      break;
    case 1:
      // TRANSITION
      tinyfont.setCursor(0, 0);
      tinyfont.print("TRANSITION");
      tinyfont.setCursor(0,5);
      tinyfont.print(generalCounter);
      goBackToMenu = false;
      disableButtons = true;
      arduboy.delayShort(10);
      generalCounter += 40;
      if ( generalCounter >= 4000 ) {
        generalCounter = 0;
        goBackToMenu = true;
        disableButtons = false;
      }
      break;
    case 2:
      // NARRATION
      goBackToMenu = false;
      while ( goBackToMenu == false) {
        arduboy.clear();
        tinyfont.setCursor(0, 0);
        tinyfont.print("NARRATION");
        arduboy.setCursor(0,10);
        arduboy.print(strcpy_P(tBuffer, (char*)pgm_read_word(&(narration[generalSelector]))));
        arduboy.pollButtons();
        if ( arduboy.justPressed(A_BUTTON) ) {
          generalSelector += 1;
        } else if ( arduboy.justPressed(B_BUTTON) ) {
          generalSelector = 0;
          goBackToMenu = true;
        }
        if ( generalSelector > 1 ) {
          generalSelector = 0;
          goBackToMenu = true;
        }
        arduboy.display();
      }
      break;
    case 3:
      // MAPBIG
      xoffseteven -= 1;
      if ( xoffseteven < -8 ) {
        xoffseteven = 0;
      }
      for ( int backgroundx = xoffseteven; backgroundx < 128; backgroundx += 8 ) {
        for ( int backgroundy = 0; backgroundy < 64; backgroundy += 8 ) {
          Sprites::drawSelfMasked(backgroundx, backgroundy, wave, 0);
        }
      }
      for ( int backgroundx = abs(xoffseteven)-4; backgroundx < 128; backgroundx += 8 ) {
        for ( int backgroundy = 4; backgroundy < 64; backgroundy += 8 ) {
          Sprites::drawSelfMasked(backgroundx, backgroundy, wave, 0);
        }
      }
      Sprites::drawSelfMasked(22, 0, hkmapbig, 0);
      tinyfont.setCursor(0, 0);
      tinyfont.print("MAPBIG");
      goBackToMenu = false;
      tinyfont.setCursor(0,5);
      tinyfont.print(generalCounter);
      tinyfont.setCursor(0,10);
      tinyfont.print(xoffseteven);
      arduboy.delayShort(10);
      generalCounter += 40;
      if ( generalCounter >= 4000 ) {
        generalCounter = 0;
        goBackToMenu = true;
      }
      break;
    case 4:
      // GAMEMAPSCR
      goBackToMenu = false;
      while ( goBackToMenu == false) {
        arduboy.clear();
        tinyfont.setCursor(0, 0);
        tinyfont.print("GAMEMAPSCR");
        tinyfont.setCursor(0, 5);
        tinyfont.print(generalSelector);
        arduboy.pollButtons();
        if ( arduboy.justPressed(A_BUTTON) || arduboy.justPressed(B_BUTTON)) {
          generalSelector = 0;
          goBackToMenu = true;
        } else if ( arduboy.justPressed(UP_BUTTON) ) {
          if ( ( generalSelector - 3 ) >= 0 ) {
            generalSelector -= 3;
          }
        } else if ( arduboy.justPressed(DOWN_BUTTON) ) {
          if ( ( generalSelector + 3 ) <= 8 ) {
            generalSelector += 3;
          }
        } else if ( arduboy.justPressed(LEFT_BUTTON) ) {
          if ( ( generalSelector - 1 ) >= 0 ) {
            generalSelector -= 1;
          }
        } else if ( arduboy.justPressed(RIGHT_BUTTON) ) {
          if ( ( generalSelector + 1 ) <= 8 ) {
            generalSelector += 1;
          }
        }
        switch ( generalSelector ) {
          case 0:
            Sprites::drawSelfMasked(0, 0, hkmap1inv, 0);
            break;
          case 1:
            Sprites::drawSelfMasked(0, 0, hkmap2inv, 0);
            break;
          case 2:
            Sprites::drawSelfMasked(0, 0, hkmap3inv, 0);
            break;
          case 3:
            Sprites::drawSelfMasked(0, 0, hkmap4inv, 0);
            break;
          case 4:
            Sprites::drawSelfMasked(0, 0, hkmap5inv, 0);
            break;
          case 5:
            Sprites::drawSelfMasked(0, 0, hkmap6inv, 0);
            break;
          case 6:
            Sprites::drawSelfMasked(0, 0, hkmap7inv, 0);
            break;
          case 7:
            Sprites::drawSelfMasked(0, 0, hkmap8inv, 0);
            break;
          case 8:
            Sprites::drawSelfMasked(0, 0, hkmap9inv, 0);
            break;
        }
        arduboy.display();
      }
      break;
    case 5:
      // GAMEMAPLOC
      tinyfont.setCursor(0, 0);
      tinyfont.print("GAMEMAPLOC");
      tinyfont.setCursor(0, 5);
      tinyfont.print(generalSelector);
      goBackToMenu = false;
      break;
    case 6:
      // PHONEHOME
      tinyfont.setCursor(0, 0);
      tinyfont.print("PHONEHOME");
      goBackToMenu = false;
      break;
    case 7:
      // PHONEMSG
      tinyfont.setCursor(0, 0);
      tinyfont.print("PHONEMSG");
      goBackToMenu = false;
      break;
    case 8:
      // SAVE
      tinyfont.setCursor(0, 0);
      tinyfont.print("SAVE");
      goBackToMenu = false;
      break;
    case 9:
      // DIALOG
      tinyfont.setCursor(0, 0);
      tinyfont.print("DIALOG");
      goBackToMenu = false;
      break;
    case 10:
      // INTRO
      goBackToMenu = false;
      while ( goBackToMenu == false ) {
        arduboy.clear();
        tinyfont.setCursor(0, 0);
        tinyfont.print("INTRO");
        tinyfont.setCursor(0, 15);
        tinyfont.print("The story, characters and\nevents in this game\nare entirely fictional.\nAny similarities to actual\npeople, places and events\nare entirely coincidental.");
        arduboy.pollButtons();
        if ( arduboy.justPressed(A_BUTTON) || arduboy.justPressed(B_BUTTON) ) {
          generalSelector = 0;
          goBackToMenu = true;
        }
        arduboy.display();
      }
      break;
    case 11:
      // LOCATION
      tinyfont.setCursor(0, 0);
      tinyfont.print("LOCATION");
      goBackToMenu = false;
      break;
    case 12:
      // NOTEBOOK
      tinyfont.setCursor(0, 0);
      tinyfont.print("NOTEBOOK");
      goBackToMenu = false;
      Sprites::drawOverwrite(0, 0, notebook, 0);
      arduboy.setTextSize(1);
      arduboy.setTextWrap(true);
      arduboy.setTextColor(BLACK);
      arduboy.print("\n  > Go see Pim\n  > Buy matches\n  > Call Chris Mophet");
      break;
  }

  if ( disableButtons == false ) {
    if ( arduboy.justPressed(B_BUTTON) ) {
      goBackToMenu = true;
      generalCounter = 0;
      generalSelector = 0;
    }
  }

  arduboy.display();
}
